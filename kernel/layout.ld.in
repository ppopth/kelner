ENTRY(_start)

SECTIONS {
    . = @KELNER_KERNEL_CODE_START@;
    .text ALIGN (0x1000) :
    {
        *(.text)
    }
    .rodata ALIGN (0x1000) :
    {
        *(.rodata)
    }
    .data ALIGN (0x1000) :
    {
        *(.data)
    }
    .bss ALIGN (0x1000) :
    {
        *(.bss)
    }
}
